## kernel_defconfig
```kconfig
#
# Minimal ARM64 kernel config: Cortex-A53 ×2, initramfs, single UART
#

CONFIG_ARM64=y
CONFIG_ARCH_VIRT=y
CONFIG_NR_CPUS=2
CONFIG_SMP=y
CONFIG_GENERIC_CPU=y
CONFIG_HAVE_ARM_SMCCC=y

# if use initramfs need these macros
# CONFIG_BLK_DEV_INITRD is not set
# CONFIG_RD_GZIP is not set

# Device Tree
CONFIG_OF=y
CONFIG_OF_FLATTREE=y
CONFIG_OF_ADDRESS=y
CONFIG_OF_EARLY_FLATTREE=y
CONFIG_ARM_PSCI_FW=y

# CPU erratum workarounds for Cortex-A53
CONFIG_ARM64_ERRATUM_845719=y

# Serial console
CONFIG_SERIAL_AMBA_PL011=y
CONFIG_SERIAL_AMBA_PL011_CONSOLE=y
CONFIG_LEGACY_PTYS=n

# no other serial drivers
CONFIG_SERIAL_8250_PCI=no

# Filesystems
CONFIG_TMPFS=y
CONFIG_TMPFS_POSIX_ACL=y
CONFIG_DEVTMPFS=y
CONFIG_PROC_FS=y
CONFIG_SYSFS=y
CONFIG_DEBUG_FS=y
CONFIG_EXT2_FS=y
CONFIG_EXT4_FS=y
CONFIG_BLK_DEV_SD=y

# No block devices
CONFIG_BLK_DEV_RAM=n
CONFIG_BLK_DEV_LOOP=n
CONFIG_MSDOS_PARTITION=n
CONFIG_FAT_FS=n
CONFIG_BTRFS_FS=n
CONFIG_NFS_FS=n
CONFIG_ISO9660_FS=n

# QEMU virtio
CONFIG_VIRTIO=y
CONFIG_VIRTIO_MMIO=y

# Network configs
CONFIG_NET=y
CONFIG_NETDEVICES=y
CONFIG_PACKET=y
CONFIG_INET=y
CONFIG_VIRTIO_NET=y
CONFIG_UNIX=y
CONFIG_IP_PNP=y
CONFIG_IP_PNP_DHCP=y
CONFIG_BRIDGE=n
CONFIG_CAN=n

# No I2C, SPI, MMC, sound, video, input, crypto modules
CONFIG_I2C=n
CONFIG_SPI=n
CONFIG_MMC=n
CONFIG_SOUND=n
CONFIG_DRM=n
CONFIG_INPUT=y
CONFIG_INPUT_MISC=n
CONFIG_HW_RANDOM=n
CONFIG_CRYPTO=n

CONFIG_PCI=y
CONFIG_PCI_HOST_GENERIC=y

CONFIG_SCSI=y

CONFIG_USB=y
CONFIG_USB_SUPPORT=y
CONFIG_USB_COMMON=y
CONFIG_USB_XHCI_HCD=y
CONFIG_USB_XHCI_PCI=y
CONFIG_USB_STORAGE=y

# Essential kernel features
CONFIG_KALLSYMS=y
CONFIG_PRINTK=y
CONFIG_PRINTK_TIME=y
CONFIG_CONSOLE_LOGLEVEL_DEFAULT=7
CONFIG_LOG_BUF_SHIFT=17

# CONFIG_MODULES is not set
# CONFIG_MODULE_UNLOAD is not set

# Scheduler, power, timers, but no ACPI/DT specific power management
CONFIG_HIGH_RES_TIMERS=y
CONFIG_ARM_GIC=y
```

## scripts/kernel.its
```
/dts-v1/;
/ {
    description = "arm64 Linux Kernel FIT Image";
    #address-cells = <1>;

    images {
        kernel {
            description = "qemu-virt image";
            data = /incbin/("/home/pzx/aarch64/linux-6.15.4/arch/arm64/boot/Image.gz");
            type = "kernel";
            arch = "arm64";
            os = "linux";
            compression = "gzip";
            load = <0x40200000>;
            entry = <0x40200000>;

            hash-1 {
                algo = "sha256";
            };
        };

        fdt {
            description = "qemu-virt dtb";
            data = /incbin/("/home/pzx/aarch64/virt.dtb");
            type = "flat_dt";
            arch = "arm64";
            compression = "none";

            hash-1 {
                algo = "sha256";
            };
        };
    };

    configurations {
        default = "defcfg";

        defcfg {
            description = "qemu uImage";
            kernel = "kernel";
            fdt = "fdt";
        };
    };
};
```

## uboot_defconfig
```kconfig
CONFIG_ARM=y
CONFIG_POSITION_INDEPENDENT=y
CONFIG_ARCH_QEMU=y
CONFIG_SYS_MALLOC_LEN=0x1000000
CONFIG_HAS_CUSTOM_SYS_INIT_SP_ADDR=y
CONFIG_CUSTOM_SYS_INIT_SP_ADDR=0x40200000
CONFIG_NR_DRAM_BANKS=1
CONFIG_DEFAULT_DEVICE_TREE="qemu-arm64"
CONFIG_SYS_LOAD_ADDR=0x40200000

# UART
CONFIG_DEBUG_UART=y
CONFIG_DEBUG_UART_PL011=y
CONFIG_DEBUG_UART_BASE=0x9000000
CONFIG_DEBUG_UART_CLOCK=0
CONFIG_DEBUG_UART_SHIFT=2

CONFIG_CMD_BOOTI=y

CONFIG_OF_LIBFDT=y
CONFIG_OF_BOARD=y
CONFIG_OF_SEPARATE=y

# PCI
CONFIG_PCI=y
CONFIG_PCI_INIT_R=y
CONFIG_PCIE_ECAM_GENERIC=y
CONFIG_CMD_PCI=y

# USB host + storage
CONFIG_USB=y
CONFIG_USB_XHCI_HCD=y
CONFIG_USB_XHCI_PCI=y
CONFIG_USB_STORAGE=y

# CONFIG_MMC is not set
# CONFIG_MTD is not set
# CONFIG_SCSI is not set
# CONFIG_NVME_PCI is not set
# CONFIG_AHCI is not set
# CONFIG_TPM is not set
# CONFIG_ENV_IS_IN_FLASH is not set
# CONFIG_FIT_SIGNATURE is not set
# CONFIG_EFI_HTTP_BOOT is not set

CONFIG_SYSRESET=y
CONFIG_SYSRESET_CMD_POWEROFF=y
CONFIG_SYSRESET_PSCI=y

# CONFIG_DISPLAY_CPUINFO is not set
# CONFIG_DISPLAY_BOARDINFO is not set

CONFIG_FIT=y
CONFIG_FIT_SIGNATURE=y
CONFIG_RSA=y
CONFIG_RSA_VERIFY_WITH_PKEY=y
CONFIG_SHA256=y
```
