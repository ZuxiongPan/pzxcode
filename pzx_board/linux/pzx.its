## pzx_board/linux/pzx.its
```
/dts-v1/;
/ {
    description = "arm64 Linux Kernel FIT Image";
    #address-cells = <1>;

    images {
        kernel {
            description = "qemu-virt image";
            data = /incbin/("/home/pzx/aarch64/linux-6.15.4/arch/arm64/boot/Image");
            type = "kernel";
            arch = "arm64";
            os = "linux";
            compression = "none";
            load = <0x81000000>;
            entry = <0x81000000>;

            hash-1 {
                algo = "sha256";
            };
        };

        fdt {
            description = "pzx arm64 dtb";
            data = /incbin/("/home/pzx/aarch64/linux-6.15.4/arch/arm64/boot/dts/arm/pzx-arm64.dtb");
            type = "flat_dt";
            arch = "arm64";
            compression = "none";

            hash-1 {
                algo = "sha256";
            };
        };
/*  this is for generate rsa public key node
        pubkey {
            description = "version publickey";
            data = /incbin/("/dev/null");

            signature {
                algo = "sha256,rsa2048";
                key-name-hint = "pzx";
            };
        };
*/
    };

    configurations {
        default = "defcfg";

        defcfg {
            description = "pzx uImage";
            kernel = "kernel";
            fdt = "fdt";
        };
    };
};
```

## pzx_board/uboot/arm64_pzx/Kconfig
```kconfig
if ARCH_ARM64_PZX

config SYS_BOARD
	default "arm64_pzx"

config SYS_CONFIG_NAME
	default "arm64_pzx"

config TEXT_BASE
	default 0x80000000

endif
```

## pzx_board/uboot/arm64_pzx_defconfig
```kconfig
CONFIG_ARM=y
CONFIG_ARCH_ARM64=y
CONFIG_ARCH_ARM64_PZX=y
CONFIG_TEXT_BASE=0x80000000
CONFIG_SYS_MALLOC_LEN=0x2000000
CONFIG_SYS_LOAD_ADDR=0x80200000
CONFIG_NR_DRAM_BANKS=1
CONFIG_DEFAULT_DEVICE_TREE="arm64-pzx"
CONFIG_OF_CONTROL=y
CONFIG_OF_SEPARATE=y

CONFIG_DM=y
CONFIG_CMD_DM=y
CONFIG_CLK=y
CONFIG_GPIO=y
CONFIG_DM_GPIO=y
CONFIG_DM_SERIAL=y
CONFIG_PL01X_SERIAL=y
CONFIG_BAUDRATE=115200
CONFIG_DM_MMC=y
CONFIG_CMD_MMC=y
CONFIG_ARM_PL180_MMCI=y

CONFIG_FIT=y
CONFIG_FIT_SIGNATURE=y
CONFIG_RSA=y
CONFIG_RSA_SOFTWARE_EXP=y
CONFIG_RSA_VERIFY_WITH_PKEY=y
CONFIG_SHA256=y
CONFIG_LIB_RAND=y
CONFIG_AES=y
```
